# LPC54114_cm4 register map
Vendor: nxp.com; File version: 1.0
LPC54114J256BD64, LPC54114J256UK49, LPC54113J256BD64, LPC54113J256UK49, LPC54113J128BD64
CPU: CM4 r0p1, little endian, MPU, FPU, VTOR, 3 interrupt priority bits
Registers are 32-bit, read-write, reset 0x0 unless marked. A register's access mark holds for its fields unless they carry their own. Offsets are from the block's base; lines under a group give offsets from that group; [hi:lo] are bit positions; {n}, {i} and the like mark numbered series; 'fields as' and 'values as' point back to an identical list; <NAME> marks a mode.

## Memory map
0x40000000 SYSCON size 0x20048 — LPC5411x System configuration (SYSCON)
0x40001000 IOCON size 0x100 — LPC5411x I/O pin configuration (IOCON)
0x40002000 GINT0 size 0x48 — LPC5411x Group GPIO input interrupt (GINT0/1)
0x40003000 GINT1 size 0x48 — LPC5411x Group GPIO input interrupt (GINT0/1)
0x40004000 PINT size 0x34 — LPC5411x Pin interrupt and pattern match (PINT)
0x40005000 INPUTMUX size 0x188 — LPC5411x Input multiplexing (INPUT MUX)
0x40008000 CTIMER0 size 0x78 — LPC5411x Standard counter/timers (CTIMER0 to 4)
0x40009000 CTIMER1 size 0x78 — LPC5411x Standard counter/timers (CTIMER0 to 4)
0x4000C000 WWDT size 0x1C — LPC5411x Windowed Watchdog Timer (WWDT)
0x4000D000 MRT0 size 0xFC — LPC5411x Multi-Rate Timer (MRT)
0x4000E000 UTICK0 size 0x20 — LPC5411x Micro-tick Timer (UTICK)
0x40028000 CTIMER2 size 0x78 — LPC5411x Standard counter/timers (CTIMER0 to 4)
0x4002C000 RTC size 0x10 — LPC5411x Real-Time Clock (RTC)
0x40040000 ASYNC_SYSCON size 0x24 — LPC5411x Asynchronous system configuration (ASYNC_SYSCON)
0x40048000 CTIMER3 size 0x78 — LPC5411x Standard counter/timers (CTIMER0 to 4)
0x40049000 CTIMER4 size 0x78 — LPC5411x Standard counter/timers (CTIMER0 to 4)
0x40080000 SPIFI0 size 0x20 — LPC5411x SPI Flash Interface (SPIFI)
0x40082000 DMA0 size 0x53C — LPC5411x DMA controller
0x40084000 USB0 size 0x38 — LPC5411x USB 2.0 Device Controller
0x40085000 SCT0 size 0x800 — LPC5411x SCTimer/PWM (SCT)
0x40086000 FLEXCOMM0 size 0x1000 — LPC5411x Flexcomm serial communication
0x40086000 I2C0 size 0x884 — LPC5411x I2C-bus interfaces
0x40086000 SPI0 size 0xE44 — LPC5411x Serial Peripheral Interfaces (SPI)
0x40086000 USART0 size 0xE44 — LPC5411x USARTs
0x40087000 FLEXCOMM1 size 0x1000 — LPC5411x Flexcomm serial communication
0x40087000 I2C1 size 0x884 — LPC5411x I2C-bus interfaces
0x40087000 SPI1 size 0xE44 — LPC5411x Serial Peripheral Interfaces (SPI)
0x40087000 USART1 size 0xE44 — LPC5411x USARTs
0x40088000 FLEXCOMM2 size 0x1000 — LPC5411x Flexcomm serial communication
0x40088000 I2C2 size 0x884 — LPC5411x I2C-bus interfaces
0x40088000 SPI2 size 0xE44 — LPC5411x Serial Peripheral Interfaces (SPI)
0x40088000 USART2 size 0xE44 — LPC5411x USARTs
0x40089000 FLEXCOMM3 size 0x1000 — LPC5411x Flexcomm serial communication
0x40089000 I2C3 size 0x884 — LPC5411x I2C-bus interfaces
0x40089000 SPI3 size 0xE44 — LPC5411x Serial Peripheral Interfaces (SPI)
0x40089000 USART3 size 0xE44 — LPC5411x USARTs
0x4008A000 FLEXCOMM4 size 0x1000 — LPC5411x Flexcomm serial communication
0x4008A000 I2C4 size 0x884 — LPC5411x I2C-bus interfaces
0x4008A000 SPI4 size 0xE44 — LPC5411x Serial Peripheral Interfaces (SPI)
0x4008A000 USART4 size 0xE44 — LPC5411x USARTs
0x4008B000 MAILBOX size 0xFC — LPC5411x Mailbox
0x4008C000 GPIO size 0x2488 — LPC5411x General Purpose I/O (GPIO)
0x40090000 DMIC0 size 0x1000 — LPC5411x DMIC Subsystem (DMIC))
0x40095000 CRC_ENGINE size 0xC — LPC5411x CRC engine
0x40096000 FLEXCOMM5 size 0x1000 — LPC5411x Flexcomm serial communication
0x40096000 I2C5 size 0x884 — LPC5411x I2C-bus interfaces
0x40096000 SPI5 size 0xE44 — LPC5411x Serial Peripheral Interfaces (SPI)
0x40096000 USART5 size 0xE44 — LPC5411x USARTs
0x40097000 FLEXCOMM6 size 0x1000 — LPC5411x Flexcomm serial communication
0x40097000 I2C6 size 0x884 — LPC5411x I2C-bus interfaces
0x40097000 I2S0 size 0xE48 — LPC5411x I2S interface
0x40097000 SPI6 size 0xE44 — LPC5411x Serial Peripheral Interfaces (SPI)
0x40097000 USART6 size 0xE44 — LPC5411x USARTs
0x40098000 FLEXCOMM7 size 0x1000 — LPC5411x Flexcomm serial communication
0x40098000 I2C7 size 0x884 — LPC5411x I2C-bus interfaces
0x40098000 I2S1 size 0xE48 — LPC5411x I2S interface
0x40098000 SPI7 size 0xE44 — LPC5411x Serial Peripheral Interfaces (SPI)
0x40098000 USART7 size 0xE44 — LPC5411x USARTs
0x400A0000 ADC0 size 0x74 — LPC5411x 12-bit ADC controller (ADC)

## Interrupts
0 WDT_BOD (WWDT)
1 DMA0
2 GINT0
3 GINT1
4 PIN_INT0 (PINT)
5 PIN_INT1 (PINT)
6 PIN_INT2 (PINT)
7 PIN_INT3 (PINT)
8 UTICK0
9 MRT0
10 CTIMER0
11 CTIMER1
12 SCT0
13 CTIMER3
14 FLEXCOMM0 (I2C0, SPI0, USART0)
15 FLEXCOMM1 (I2C1, SPI1, USART1)
16 FLEXCOMM2 (I2C2, SPI2, USART2)
17 FLEXCOMM3 (I2C3, SPI3, USART3)
18 FLEXCOMM4 (I2C4, SPI4, USART4)
19 FLEXCOMM5 (I2C5, SPI5, USART5)
20 FLEXCOMM6 (I2C6, I2S0, SPI6, USART6)
21 FLEXCOMM7 (I2C7, I2S1, SPI7, USART7)
22 ADC0_SEQA (ADC0)
23 ADC0_SEQB (ADC0)
24 ADC0_THCMP (ADC0)
25 DMIC0
26 HWVAD0 (DMIC0)
27 USB0_NEEDCLK (USB0)
28 USB0
29 RTC
31 MAILBOX
32 PIN_INT4 (PINT)
33 PIN_INT5 (PINT)
34 PIN_INT6 (PINT)
35 PIN_INT7 (PINT)
36 CTIMER2
37 CTIMER4
39 SPIFI0
